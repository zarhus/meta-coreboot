## conf/layer.conf
```bitbake
BBPATH .= ":${LAYERDIR}"

BBFILES += "${LAYERDIR}/recipes-*/*/*.bb \
            ${LAYERDIR}/recipes-*/*/*.bbappend \
            "

BBFILE_COLLECTIONS += "coreboot"
BBFILE_PATTERN_coreboot = "^${LAYERDIR}/"
BBFILE_PRIORITY_coreboot = "8"

LAYERVERSION_coreboot = "1"

LAYERSERIES_COMPAT_coreboot = "scarthgap master"
```
